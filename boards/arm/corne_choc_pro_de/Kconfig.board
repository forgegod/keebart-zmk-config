## boards/arm/corne_choc_pro_de/Kconfig.board
```kconfig
# Copyright (c) 2020 The ZMK Contributors
# SPDX-License-Identifier: MIT

config BOARD_CORNE_CHOC_PRO_DE_LEFT
	bool "Corne Choc Pro DE Left"
	depends on SOC_NRF52840_QIAA

config BOARD_CORNE_CHOC_PRO_DE_RIGHT
	bool "Corne Choc Pro DE Right"
	depends on SOC_NRF52840_QIAA
```

## boards/arm/piantor_pro_bt_de/Kconfig
```kconfig
# SPDX-License-Identifier: MIT

config BOARD_ENABLE_DCDC
	bool "Enable DCDC mode"
	select SOC_DCDC_NRF52X
	default y
	depends on (BOARD_PIANTOR_PRO_BT_DE_LEFT || BOARD_PIANTOR_PRO_BT_DE_RIGHT)
```

## boards/arm/piantor_pro_bt_de/Kconfig.board
```kconfig
# Copyright (c) 2020 The ZMK Contributors
# SPDX-License-Identifier: MIT

config BOARD_PIANTOR_PRO_BT_DE_LEFT
	bool "Piantor Pro BT DE Left"
	depends on SOC_NRF52840_QIAA

config BOARD_PIANTOR_PRO_BT_DE_RIGHT
    bool "Piantor Pro BT DE Right"
    depends on SOC_NRF52840_QIAA
```
